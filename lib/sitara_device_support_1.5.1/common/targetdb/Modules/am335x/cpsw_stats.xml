# cpsw_stats register map
Vendor: Texas Instruments
Peripheral module from a debugger description file (folder am335x).
Registers are 32-bit, access not given, no defined reset value unless marked. A register's access mark holds for its fields unless they carry their own. Offsets are as the file gives them; lines under a group give offsets from that group; [hi:lo] are bit positions; {n}, {i} and the like mark numbered series; 'fields as' and 'values as' point back to an identical list; <NAME> marks a mode.

## cpsw_stats
0x00 GOODRX — Good Rx Frames
0x04 BROADCAST_RX_FRAMES
0x08 MULTICAST_RX_FRAMES
0x0C PAUSE_RX_FRAMES
0x10 RX_CRC_ERRORS
0x14 RX_ALIGN_ERRORS
0x18 OVERSIZE_RX_FRAMES
0x1C RX_JABBERS
0x20 UNDERSIZE_RX_FRAMES
0x24 RX_FRAGMENTS
0x30 RX_OCTETS
0x34 GOOD_TX_FRAMES
0x38 BROADCAST_TX_FRAMES
0x3C MULTICAST_TX_FRAMES
0x40 PAUSE_TX_FRAMES
0x44 DEFERRED_TX_FRAMES
0x48 COLLISIONS
0x4C SINGLE_COLLISION_TX_FRAMES
0x50 MULTIPLE_COLLISION_TX_FRAMES
0x54 EXCESSIVE_COLLISIONS
0x58 LATE_COLLISIONS
0x5C TX_UNDERRUN
0x60 CARRIER_SENSE_ERRORS
0x64 TX_OCTETS
0x68 RX_TX_64_OCTET_FRAMES
0x6C RX_TX_65_OCTET_FRAMES — Rx + Tx 65-127 Octet Frames
0x70 RX_TX_128_OCTET_FRAMES — Rx + Tx 128-255 Octet Frames
0x74 RX_TX_256_OCTET_FRAMES — Rx + Tx 256-511 Octet Frames
0x78 RX_TX_512_OCTET_FRAMES — Rx + Tx 512-1023 Octet Frames
0x7C RX_TX_1024_OCTET_FRAMES — Rx + Tx 1204_Up Octet Frames
0x80 NET_OCTETS
0x84 RX_START_OF_FRAME_OVERRUNS
0x88 RX_MIDDLE_OF_FRAME_OVERRUNS
0x8C RX_DMA_OVERRUNS
